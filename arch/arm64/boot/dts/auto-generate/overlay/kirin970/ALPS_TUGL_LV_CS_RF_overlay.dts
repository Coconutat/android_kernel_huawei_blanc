
/**
 * Copyright (C) 2014 Hisilicon Ltd.
 *
 *  This program is free software; you can redistribute it and/or modify
 *  it under the terms of the GNU General Public License version 2 as
 *  publishhed by the Free Software Foundation.
 */

/dts-v1/;
/plugin/;
/include/ "ALPS_TUGL_VN1_CS_G_WIFI_PMIC_overlay.dtsi"

/ {
	board_id = <6424>;
};
&rootparam {
        hisi,dtbo_idx = <121>;
    hisi,boardid = <6 4 2 4>;
    hisi,boardname = "ALPS_TUGL_LV_CS_RF";
};

