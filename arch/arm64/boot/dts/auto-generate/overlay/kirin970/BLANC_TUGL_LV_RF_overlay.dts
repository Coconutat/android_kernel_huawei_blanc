
/**
 * Copyright (C) 2014 Hisilicon Ltd.
 *
 *  This program is free software; you can redistribute it and/or modify
 *  it under the terms of the GNU General Public License version 2 as
 *  publishhed by the Free Software Foundation.
 */

/dts-v1/;
/plugin/;
/include/ "BLANC_TUGL_VN1_ANTI_overlay.dtsi"

/ {
	board_id = <6461>;
};

&rootparam {
        hisi,dtbo_idx = <9>;
    hisi,boardid = <6 4 6 1>;
    hisi,boardname = "BLANC_TUGL_LV_RF";
};

