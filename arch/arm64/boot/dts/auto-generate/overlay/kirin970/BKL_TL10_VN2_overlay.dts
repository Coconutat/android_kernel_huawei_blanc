
/**
 * Copyright (C) 2014 Hisilicon Ltd.
 *
 *  This program is free software; you can redistribute it and/or modify
 *  it under the terms of the GNU General Public License version 2 as
 *  publishhed by the Free Software Foundation.
 */

/dts-v1/;
/plugin/;
/include/ "BKL_TL10_VN1_overlay.dtsi"

/ {
	board_id = <6990>;
};

&rootparam {
        hisi,dtbo_idx = <142>;
    hisi,boardid = <6 9 9 0>;
    hisi,boardname = "BKL_TL10_VN2";
};

	&huawei_lcd_panel {
		product_id = <3002>;
	};