
/**
 * Copyright (C) 2014 Hisilicon Ltd.
 *
 *  This program is free software; you can redistribute it and/or modify
 *  it under the terms of the GNU General Public License version 2 as
 *  publishhed by the Free Software Foundation.
 */

/dts-v1/;
/plugin/;
/include/ "VCE_AL00_VA_overlay.dtsi"

/ {
	board_id = <6973>;
};
&rootparam {
        hisi,dtbo_idx = <161>;
    hisi,boardid = <6 9 7 3>;
    hisi,boardname = "VCE_TL00_VA";
};