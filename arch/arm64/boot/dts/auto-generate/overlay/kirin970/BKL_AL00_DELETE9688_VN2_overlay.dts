
/**
 * Copyright (C) 2014 Hisilicon Ltd.
 *
 *  This program is free software; you can redistribute it and/or modify
 *  it under the terms of the GNU General Public License version 2 as
 *  publishhed by the Free Software Foundation.
 */

/dts-v1/;
/plugin/;
/include/ "BKL_AL00_DELETE9688_VN1_overlay.dtsi"

/ {
	board_id = <6944>;
};

&rootparam {
        hisi,dtbo_idx = <129>;
    hisi,boardid = <6 9 4 4>;
    hisi,boardname = "BKL_AL00_DELETE9688_VN2";
};

	&huawei_lcd_panel {
		product_id = <3002>;
	};