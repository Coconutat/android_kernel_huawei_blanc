
/**
 * Copyright (C) 2014 Hisilicon Ltd.
 *
 *  This program is free software; you can redistribute it and/or modify
 *  it under the terms of the GNU General Public License version 2 as
 *  publishhed by the Free Software Foundation.
 */

/dts-v1/;
/plugin/;
/include/ "COR_TL10_VD_overlay.dtsi"

/ {
	board_id = <6939>;
};

&rootparam {
        hisi,dtbo_idx = <134>;
    hisi,boardid = <6 9 3 9>;
    hisi,boardname = "COR_TL10_VE";
};

	&invert_hs {
		status = "disabled";
	};
