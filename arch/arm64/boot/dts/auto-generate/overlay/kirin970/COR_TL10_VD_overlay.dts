
/**
 * Copyright (C) 2014 Hisilicon Ltd.
 *
 *  This program is free software; you can redistribute it and/or modify
 *  it under the terms of the GNU General Public License version 2 as
 *  publishhed by the Free Software Foundation.
 */

/dts-v1/;
/plugin/;
/include/ "COR_TL10_VC_overlay.dtsi"

/ {
	board_id = <6964>;
};
&rootparam {
        hisi,dtbo_idx = <197>;
    hisi,boardid = <6 9 6 4>;
    hisi,boardname = "COR_TL10_VD";
};

