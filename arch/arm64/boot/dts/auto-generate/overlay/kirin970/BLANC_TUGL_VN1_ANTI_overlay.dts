
/**
 * Copyright (C) 2014 Hisilicon Ltd.
 *
 *  This program is free software; you can redistribute it and/or modify
 *  it under the terms of the GNU General Public License version 2 as
 *  publishhed by the Free Software Foundation.
 */

/dts-v1/;
/plugin/;
/include/ "BLANC_TUGL_VN1_WIFI_PMIC_RF_overlay.dtsi"

/ {
	board_id = <6459>;
};

&rootparam {
        hisi,dtbo_idx = <82>;
    hisi,boardid = <6 4 5 9>;
    hisi,boardname = "BLANC_TUGL_VN1_ANTI";
};

