
/**
 * Copyright (C) 2014 Hisilicon Ltd.
 *
 *  This program is free software; you can redistribute it and/or modify
 *  it under the terms of the GNU General Public License version 2 as
 *  publishhed by the Free Software Foundation.
 */

/include/ "EMILY_LX9_V3_overlay.dtsi"
/include/ "EMILY_LX9_V3_PHILIPPINE_overlay_module_amba.dts"

/ {
        board_id = <6508>;
};

&rootparam {
    hisi,boardid = <6 5 0 8>;
    hisi,boardname = "EMILY_LX9_V3_PHILIPPINE";
};

        &huawei_lcd_panel {
                product_id = <4001>;
        };
&direct_charger {
	min_dc_bat_vol = <3550>;
};
