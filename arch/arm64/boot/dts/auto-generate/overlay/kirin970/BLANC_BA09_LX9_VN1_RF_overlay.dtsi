
/**
 * Copyright (C) 2014 Hisilicon Ltd.
 *
 *  This program is free software; you can redistribute it and/or modify
 *  it under the terms of the GNU General Public License version 2 as
 *  publishhed by the Free Software Foundation.
 */

/include/ "BLANC_BA09_LX9_V4_BAK_overlay.dtsi"

/ {
	board_id = <6475>;
};

&rootparam {
    hisi,boardid = <6 4 7 5>;
    hisi,boardname = "BLANC_BA09_LX9_VN1_RF";
};

