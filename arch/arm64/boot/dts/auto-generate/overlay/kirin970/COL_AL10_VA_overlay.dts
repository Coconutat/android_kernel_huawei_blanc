
/**
 * Copyright (C) 2014 Hisilicon Ltd.
 *
 *  This program is free software; you can redistribute it and/or modify
 *  it under the terms of the GNU General Public License version 2 as
 *  publishhed by the Free Software Foundation.
 */

/dts-v1/;
/plugin/;
/include/ "COL_AL00_VA_overlay.dtsi"

/ {
	board_id = <6802>;
};
&rootparam {
        hisi,dtbo_idx = <110>;
    hisi,boardid = <6 8 0 2>;
    hisi,boardname = "COL_AL10_VA";
};

