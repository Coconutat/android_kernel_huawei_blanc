
/**
 * Copyright (C) 2014 Hisilicon Ltd.
 *
 *  This program is free software; you can redistribute it and/or modify
 *  it under the terms of the GNU General Public License version 2 as
 *  publishhed by the Free Software Foundation.
 */

/dts-v1/;
/plugin/;
/include/ "PAR_LX1_VA_overlay.dtsi"

/ {
	board_id = <6862>;
};

&rootparam {
        hisi,dtbo_idx = <60>;
    hisi,boardid = <6 8 6 2>;
    hisi,boardname = "PAR_LX1_VB";
};

&deviceboxID {
	speaker_map = <1 3>;/*3 means GD, 1 means AAC*/
};
