
/**
 * Copyright (C) 2014 Hisilicon Ltd.
 *
 *  This program is free software; you can redistribute it and/or modify
 *  it under the terms of the GNU General Public License version 2 as
 *  publishhed by the Free Software Foundation.
 */

/include/ "COR_TL10_VE_overlay.dtsi"

/ {
	board_id = <6938>;
};
&rootparam {
    hisi,boardid = <6 9 3 8>;
    hisi,boardname = "COR_TL10_VF";
};
	&invert_hs {
		status = "disabled";
	};
