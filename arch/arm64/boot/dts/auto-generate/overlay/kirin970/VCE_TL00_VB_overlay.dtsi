
/**
 * Copyright (C) 2014 Hisilicon Ltd.
 *
 *  This program is free software; you can redistribute it and/or modify
 *  it under the terms of the GNU General Public License version 2 as
 *  publishhed by the Free Software Foundation.
 */

/include/ "VCE_TL00_VA_overlay.dtsi"

/ {
	board_id = <6974>;
};
&rootparam {
    hisi,boardid = <6 9 7 4>;
    hisi,boardname = "VCE_TL00_VB";
};
