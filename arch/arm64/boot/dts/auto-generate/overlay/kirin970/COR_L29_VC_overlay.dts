
/**
 * Copyright (C) 2014 Hisilicon Ltd.
 *
 *  This program is free software; you can redistribute it and/or modify
 *  it under the terms of the GNU General Public License version 2 as
 *  publishhed by the Free Software Foundation.
 */

/dts-v1/;
/plugin/;
/include/ "COR_L29_VB_overlay.dtsi"

/ {
	board_id = <6955>;
};
&rootparam {
        hisi,dtbo_idx = <176>;
    hisi,boardid = <6 9 5 5>;
    hisi,boardname = "COR_L29_VC";
};

