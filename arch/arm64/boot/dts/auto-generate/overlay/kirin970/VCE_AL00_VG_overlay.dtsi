
/**
 * Copyright (C) 2014 Hisilicon Ltd.
 *
 *  This program is free software; you can redistribute it and/or modify
 *  it under the terms of the GNU General Public License version 2 as
 *  publishhed by the Free Software Foundation.
 */

/include/ "VCE_AL00_VE_overlay.dtsi"

/ {
	board_id = <6980>;
};
&rootparam {
    hisi,boardid = <6 9 8 0>;
    hisi,boardname = "VCE_AL00_VG";
};

