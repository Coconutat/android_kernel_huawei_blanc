
/**
 * Copyright (C) 2014 Hisilicon Ltd.
 *
 *  This program is free software; you can redistribute it and/or modify
 *  it under the terms of the GNU General Public License version 2 as
 *  publishhed by the Free Software Foundation.
 */

/dts-v1/;
/plugin/;
/include/ "BLANC_BA09_LX9_V3_C_overlay.dtsi"

/ {
	board_id = <6472>;
};

&rootparam {
        hisi,dtbo_idx = <163>;
    hisi,boardid = <6 4 7 2>;
    hisi,boardname = "BLANC_BA09_LX9_V3_DE";
};

