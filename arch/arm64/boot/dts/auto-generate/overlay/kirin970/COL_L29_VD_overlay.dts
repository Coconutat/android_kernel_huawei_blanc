
/**
 * Copyright (C) 2014 Hisilicon Ltd.
 *
 *  This program is free software; you can redistribute it and/or modify
 *  it under the terms of the GNU General Public License version 2 as
 *  publishhed by the Free Software Foundation.
 */

/dts-v1/;
/plugin/;
/include/ "COL_L29_VC_overlay.dtsi"

/ {
	board_id = <6819>;
};
&rootparam {
        hisi,dtbo_idx = <177>;
    hisi,boardid = <6 8 1 9>;
    hisi,boardname = "COL_L29_VD";
};

