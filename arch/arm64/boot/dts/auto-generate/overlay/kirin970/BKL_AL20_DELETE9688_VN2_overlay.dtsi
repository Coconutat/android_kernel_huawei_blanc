
/**
 * Copyright (C) 2014 Hisilicon Ltd.
 *
 *  This program is free software; you can redistribute it and/or modify
 *  it under the terms of the GNU General Public License version 2 as
 *  publishhed by the Free Software Foundation.
 */

/include/ "BKL_AL20_DELETE9688_VN1_overlay.dtsi"

/ {
	board_id = <6945>;
};

&rootparam {
    hisi,boardid = <6 9 4 5>;
    hisi,boardname = "BKL_AL20_DELETE9688_VN2";
};

	&huawei_lcd_panel {
		product_id = <3002>;
	};