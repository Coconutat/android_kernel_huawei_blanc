
/**
 * Copyright (C) 2014 Hisilicon Ltd.
 *
 *  This program is free software; you can redistribute it and/or modify
 *  it under the terms of the GNU General Public License version 2 as
 *  publishhed by the Free Software Foundation.
 */

/dts-v1/;
/plugin/;
/include/ "PAR_LX1_VB_overlay.dtsi"

/ {
	board_id = <6863>;
};
&rootparam {
        hisi,dtbo_idx = <73>;
    hisi,boardid = <6 8 6 3>;
    hisi,boardname = "PAR_LX1_VC";
};

