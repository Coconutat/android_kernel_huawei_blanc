
/**
 * Copyright (C) 2014 Hisilicon Ltd.
 *
 *  This program is free software; you can redistribute it and/or modify
 *  it under the terms of the GNU General Public License version 2 as
 *  publishhed by the Free Software Foundation.
 */

/include/ "BLANC_BA09_LX9_V0_overlay.dtsi"

/ {
	board_id = <6471>;
};

&rootparam {
    hisi,boardid = <6 4 7 1>;
    hisi,boardname = "BLANC_BA09_LX9_V3_C";
};


&direct_charge_ps {
	bst_ctrl = <&gpio23 1 0>;
	bst_ctrl_use_common_gpio = <0>;
};
