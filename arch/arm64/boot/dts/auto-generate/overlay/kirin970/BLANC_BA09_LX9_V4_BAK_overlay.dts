
/**
 * Copyright (C) 2014 Hisilicon Ltd.
 *
 *  This program is free software; you can redistribute it and/or modify
 *  it under the terms of the GNU General Public License version 2 as
 *  publishhed by the Free Software Foundation.
 */

/dts-v1/;
/plugin/;
/include/ "BLANC_BA09_LX9_V4_overlay.dtsi"

/ {
	board_id = <6474>;
};

&rootparam {
        hisi,dtbo_idx = <118>;
    hisi,boardid = <6 4 7 4>;
    hisi,boardname = "BLANC_BA09_LX9_V4_BAK";
};

