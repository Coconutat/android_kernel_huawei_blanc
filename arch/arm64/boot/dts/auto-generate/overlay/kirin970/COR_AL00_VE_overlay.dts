
/**
 * Copyright (C) 2014 Hisilicon Ltd.
 *
 *  This program is free software; you can redistribute it and/or modify
 *  it under the terms of the GNU General Public License version 2 as
 *  publishhed by the Free Software Foundation.
 */

/dts-v1/;
/plugin/;
/include/ "COR_AL00_VD_overlay.dtsi"

/ {
	board_id = <6919>;
};

&rootparam {
        hisi,dtbo_idx = <1>;
    hisi,boardid = <6 9 1 9>;
    hisi,boardname = "COR_AL00_VE";
};

	&invert_hs {
		status = "disabled";
	};
