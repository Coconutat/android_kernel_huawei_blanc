/*ts kit*/
&ts_kit {
	bus_type = "i2c";
	product = "ravel";
	bus_id = <7>;
	has_virtualkey = <0>;
	fpga_flag = <0>;
	irq_gpio = <&gpio26 4 0>;
	reset_gpio = <&gpio1 7 0>;
	aft_enable = <1>;

	touchscreen@90 {
		compatible = "sec_ts";
		i2c_address = <0x48>;
		ic_type = <0>; /* oncell */
		algo_id = <1>;
		charger_notify_gpio = <&gpio16 4 0>;
		y_max_mt = <4096>;
		x_max_mt = <4096>;
		y_max = <4096>;
		x_max = <4096>;
		use_ic_res = <1>;
		x_max_rc = <1079>;
		y_max_rc = <2219>;
		irq_config = <0>;
		raw_data_limit ="474", "180", /* mutual raw cap max min*/
				"80", "80", /* mutual raw cap gap col max raw max*/
				"45", "-45", /* mutual detla max min*/
				"-1180", "-3000", /* self raw cap long(tx) max min*/
				"920", "-120", /* self raw cap short(rx) max min*/
				"999999", "-999999", /* self detla long(tx) max min*/
				"999999", "-999999"; /* self detla short(rx) max min*/
		cal_data_limit = "99999", "99999", "99999";
		pinctrl-names = "default", "idle";
		pinctrl-0 = <&gpio015_pmx_func &gpio212_pmx_func &gpio015_cfg_func &gpio212_cfg_func>;
		pinctrl-1 = <&gpio015_pmx_idle &gpio212_pmx_idle &gpio015_cfg_idle &gpio212_cfg_idle>;
		is_need_set_pinctrl = <1>;
		ic_name = <1>;
		is_need_set_reseved_bit = <1>;
		sec_ts-dvdd-supply;
		sec_ts-avdd-supply;
		dvdd_value = <1850000>;
		avdd_value = <3300000>;
		i2c-burstmax = <256>;
		max_x = <4095>;
		max_y = <4095>;
		vddio_regulator_type = <0>;
		vddio_gpio_type = <1>;
		vddio_ctrl_gpio = <&gpio17 1 0>;
		vci_regulator_type = <0>;
		vci_gpio_type = <1>;
		vci_ctrl_gpio = <&gpio28 3 0>;
		default_projectid = "RAVE740900";
		supported_func_indicater = <1>;
		use_lcdkit_power_notify = <1>;
		holster_supported = <0>;
		charger_supported = <1>;
		tx_default_num = <17>;
		rx_default_num = <34>;
		is_need_calibrate_after_update_fw = <0>;
		tp_test_type = "Normalize_type:judge_different_reslut";
		RAVE740900 {
			compatible = "sec_ts-RAVE740900";
			producer = "sdc";
			roi_data_addr = <0x75>;
			roi_control_bit = <0>;
			roi_control_addr = <0x76>;
			roi_supported = <1>;
		};
	};
};
