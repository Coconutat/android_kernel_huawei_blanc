/*
 * Hisilicon Ltd. SoC
 *
 * Copyright (C) 2012-2013 Hisilicon Ltd.
 * Author: nobody
 *
 * This program is free software; you can redistribute it and/or modify
 * it under the terms of the GNU General Public License version 2 as
 * publishhed by the Free Software Foundation.
 */

	&modem_pinctrl {
		compatible = "arm,modem_pinctrl";
			pinctrl-names = "init","default","idle";
			/*table: gpio_group gpio_pin mux_addr mux_value cfg_addr cfg_value gpio_dir gpio_value*/
			pinctrl-0 = <
					 7         2      0x0AC           2        0x0B0      0     0xffff     0xffff
					 7         5      0x0B8           0        0x0BC      0          1          0
					 7         6      0x0BC           4        0x0C0      0     0xffff     0xffff
					 7         7      0x0C0           0        0x0C4      0          1          0
					 8         0      0x0C4           1        0x0C8      0          1          0
					 8         1      0x0C8           1        0x0CC      0          1          0
					 8         2      0x0CC           1        0x0D0      0          1          0
					 8         3      0x0D0           1        0x0D4      0          1          0
					 8         4      0x0D4           1        0x0D8      0          1          0
					 8         5      0x0D8           1        0x0DC      0          1          0
					 8         6      0x0DC           1        0x0E0      0          1          0
					 8         7      0x0E0           1        0x0E4      0          1          0
					11         0      0x124           1        0x128      0     0xffff     0xffff
					11         1      0x128           1        0x12C      2     0xffff     0xffff
					11         2      0x12C           1        0x130      0     0xffff     0xffff
					11         3      0x130           1        0x134      2     0xffff     0xffff
					11         6      0x13C           1        0x140      0     0xffff     0xffff
					11         7      0x140           1        0x144      2     0xffff     0xffff
					12         0      0x144           1        0x148      0     0xffff     0xffff
					18         5      0x0AC           3        0x0DC      0     0xffff     0xffff
					24         5      0x04C           0        0x078      1          0     0xffff
					>;
			pinctrl-1 = <
					 7         2      0x0AC           2        0x0B0      0     0xffff     0xffff
					 7         5      0x0B8           0        0x0BC      0     0xffff     0xffff
					 7         6      0x0BC           4        0x0C0      0     0xffff     0xffff
					 7         7      0x0C0           0        0x0C4      0     0xffff     0xffff
					 8         0      0x0C4      0xffff        0x0C8      0xffff     0xffff     0xffff
					 8         1      0x0C8           1        0x0CC      0          1          0
					 8         2      0x0CC           1        0x0D0      0          1          0
					 8         3      0x0D0           1        0x0D4      0          1          0
					 8         4      0x0D4           1        0x0D8      0          1          0
					 8         5      0x0D8           1        0x0DC      0          1          0
					 8         6      0x0DC           1        0x0E0      0          1          0
					 8         7      0x0E0           1        0x0E4      0          1          0
					11         0      0x124           1        0x128      0     0xffff     0xffff
					11         1      0x128           1        0x12C      2     0xffff     0xffff
					11         2      0x12C           1        0x130      0     0xffff     0xffff
					11         3      0x130           1        0x134      2     0xffff     0xffff
					11         6      0x13C           1        0x140      0     0xffff     0xffff
					11         7      0x140           1        0x144      2     0xffff     0xffff
					12         0      0x144           1        0x148      0     0xffff     0xffff
					18         5      0x0AC           3        0x0DC      0     0xffff     0xffff
					24         5      0x04C           0        0x078      1          0     0xffff
					>;
			pinctrl-2 = <
					 7         2      0x0AC           2        0x0B0      0     0xffff     0xffff
					 7         5      0x0B8           0        0x0BC      0     0xffff     0xffff
					 7         6      0x0BC           4        0x0C0      0     0xffff     0xffff
					 7         7      0x0C0           0        0x0C4      0     0xffff     0xffff
					 8         0      0x0C4      0xffff        0x0C8      0xffff     0xffff     0xffff
					 8         1      0x0C8           1        0x0CC      0          1          0
					 8         2      0x0CC           1        0x0D0      0          1          0
					 8         3      0x0D0           1        0x0D4      0          1          0
					 8         4      0x0D4           1        0x0D8      0          1          0
					 8         5      0x0D8           1        0x0DC      0          1          0
					 8         6      0x0DC           1        0x0E0      0          1          0
					 8         7      0x0E0           1        0x0E4      0          1          0
					11         0      0x124           1        0x128      0     0xffff     0xffff
					11         1      0x128           1        0x12C      2     0xffff     0xffff
					11         2      0x12C           1        0x130      0     0xffff     0xffff
					11         3      0x130           1        0x134      2     0xffff     0xffff
					11         6      0x13C           1        0x140      0     0xffff     0xffff
					11         7      0x140           1        0x144      2     0xffff     0xffff
					12         0      0x144           1        0x148      0     0xffff     0xffff
					18         5      0x0AC           3        0x0DC      0     0xffff     0xffff
					24         5      0x04C           0        0x078      1          0     0xffff
					>;
			pinctrl-num   = <21 21 21>;
			status = "ok";
	};
