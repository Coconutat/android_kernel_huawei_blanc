
/**
 * Copyright (C) 2014 Hisilicon Ltd.
 *
 *  This program is free software; you can redistribute it and/or modify
 *  it under the terms of the GNU General Public License version 2 as
 *  publishhed by the Free Software Foundation.
 */

/include/ "NEO_TUGL_V2_FP_overlay.dtsi"

/ {
        board_id = <6485>;
};

&rootparam {
    hisi,boardid = <6 4 8 5>;
    hisi,boardname = "NEO_TUGL_V2_FP_OPT";
};


&fingerprint {
	spi-max-frequency = <5000000>;
	fingerprint,product = "neo";

	fingerprint,navigation_adjust1 = <1>;
	fingerprint,navigation_adjust2 = <0>;

	fingerprint,fpc2050 = <1>;
	fingerprint,reset_gpio_ud = <211>;
	fingerprint,irq_gpio_ud = <147>;
	fingerprint,cs_gpio_ud = <216>;
	fingerprint,spi_num = <2>;
	fingerprint,force_storage_type = <1>;
	fingerprint,sensor_type = <516>;
	fingerprint,top_left_corner_x = <459>;
	fingerprint,top_left_corner_y = <628>;
	fingerprint,bottom_right_corner_x = <540>;
	fingerprint,bottom_right_corner_y = <669>;
	fingerprint,tp_hover_support = <1>;
	pinctrl-names = "default", "idle";
};

