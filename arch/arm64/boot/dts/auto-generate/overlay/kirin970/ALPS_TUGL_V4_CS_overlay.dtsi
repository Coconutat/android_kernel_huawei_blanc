
/**
 * Copyright (C) 2014 Hisilicon Ltd.
 *
 *  This program is free software; you can redistribute it and/or modify
 *  it under the terms of the GNU General Public License version 2 as
 *  publishhed by the Free Software Foundation.
 */

/include/ "ALPS_TUGL_V3_CS_2LANE_overlay.dtsi"

/ {
	board_id = <6414>;
};

&rootparam {
    hisi,boardid = <6 4 1 4>;
    hisi,boardname = "ALPS_TUGL_V4_CS";
};

