
/**
 * Copyright (C) 2014 Hisilicon Ltd.
 *
 *  This program is free software; you can redistribute it and/or modify
 *  it under the terms of the GNU General Public License version 2 as
 *  publishhed by the Free Software Foundation.
 */

/include/ "CHARLOTTE_DCM_V1_overlay.dtsi"

/ {
        board_id = <6533>;
};

&rootparam {
    hisi,boardid = <6 5 3 3>;
    hisi,boardname = "CHARLOTTE_DCM_V2";
};


&dp_aux_switch {
    aux_switch_from_fsa4476;
    status = "ok";
};