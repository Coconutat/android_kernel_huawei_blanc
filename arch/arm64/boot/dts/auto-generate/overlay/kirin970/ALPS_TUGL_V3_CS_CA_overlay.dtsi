
/**
 * Copyright (C) 2014 Hisilicon Ltd.
 *
 *  This program is free software; you can redistribute it and/or modify
 *  it under the terms of the GNU General Public License version 2 as
 *  publishhed by the Free Software Foundation.
 */

/include/ "ALPS_TUGL_V1_CS_overlay.dtsi"

/ {
	board_id = <6411>;
};

&rootparam {
    hisi,boardid = <6 4 1 1>;
    hisi,boardname = "ALPS_TUGL_V3_CS_CA";
};

	&huawei_lcd_panel {
		product_id = <1001>;
	};
