
/**
 * Copyright (C) 2014 Hisilicon Ltd.
 *
 *  This program is free software; you can redistribute it and/or modify
 *  it under the terms of the GNU General Public License version 2 as
 *  publishhed by the Free Software Foundation.
 */

/dts-v1/;
/plugin/;
/include/ "BLANC_LX9_VN1_RF_overlay.dtsi"

/ {
	board_id = <6458>;
};

&huawei_lcd_panel {
        product_id = <2001>;
};

&rootparam {
        hisi,dtbo_idx = <39>;
    hisi,boardid = <6 4 5 8>;
    hisi,boardname = "BLANC_LX9_VN1_ANTI";
};

&coul_core {
	basp_mask_delay = <0>;
};
