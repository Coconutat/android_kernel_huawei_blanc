
/**
 * Copyright (C) 2014 Hisilicon Ltd.
 *
 *  This program is free software; you can redistribute it and/or modify
 *  it under the terms of the GNU General Public License version 2 as
 *  publishhed by the Free Software Foundation.
 */

/dts-v1/;
/plugin/;
/include/ "EMILY_TUGL_V3_overlay.dtsi"

/ {
        board_id = <6505>;
};

&rootparam {
        hisi,dtbo_idx = <152>;
    hisi,boardid = <6 5 0 5>;
    hisi,boardname = "EMILY_TUGL_V3_POWER";
};


        &huawei_lcd_panel {
                product_id = <4003>;
        };
