
/**
 * Copyright (C) 2014 Hisilicon Ltd.
 *
 *  This program is free software; you can redistribute it and/or modify
 *  it under the terms of the GNU General Public License version 2 as
 *  publishhed by the Free Software Foundation.
 */

/include/ "COR_AL10_VD_overlay.dtsi"

/ {
	board_id = <6929>;
};

&rootparam {
    hisi,boardid = <6 9 2 9>;
    hisi,boardname = "COR_AL10_VE";
};

	&invert_hs {
		status = "disabled";
	};
