
/**
 * Copyright (C) 2014 Hisilicon Ltd.
 *
 *  This program is free software; you can redistribute it and/or modify
 *  it under the terms of the GNU General Public License version 2 as
 *  publishhed by the Free Software Foundation.
 */

/dts-v1/;
/plugin/;
/include/ "VCE_AL00_VB_overlay.dtsi"

/ {
	board_id = <6975>;
};
&rootparam {
        hisi,dtbo_idx = <122>;
    hisi,boardid = <6 9 7 5>;
    hisi,boardname = "VCE_AL00_VC";
};

&huawei_imx586 {
	compatible = "huawei,imx586";
	avdd-supply = <&ldo13>;

};
