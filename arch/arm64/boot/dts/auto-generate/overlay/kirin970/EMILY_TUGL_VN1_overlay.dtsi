
/**
 * Copyright (C) 2014 Hisilicon Ltd.
 *
 *  This program is free software; you can redistribute it and/or modify
 *  it under the terms of the GNU General Public License version 2 as
 *  publishhed by the Free Software Foundation.
 */

/include/ "EMILY_TUGL_V4_overlay.dtsi"

/ {
        board_id = <6512>;
};

&rootparam {
    hisi,boardid = <6 5 1 2>;
    hisi,boardname = "EMILY_TUGL_VN1";
};

