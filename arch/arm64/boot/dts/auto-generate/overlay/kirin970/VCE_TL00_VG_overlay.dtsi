
/**
 * Copyright (C) 2014 Hisilicon Ltd.
 *
 *  This program is free software; you can redistribute it and/or modify
 *  it under the terms of the GNU General Public License version 2 as
 *  publishhed by the Free Software Foundation.
 */

/include/ "VCE_TL00_VE_overlay.dtsi"

/ {
	board_id = <6989>;
};
&rootparam {
    hisi,boardid = <6 9 8 9>;
    hisi,boardname = "VCE_TL00_VG";
};

