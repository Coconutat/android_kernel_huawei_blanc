
/**
 * Copyright (C) 2014 Hisilicon Ltd.
 *
 *  This program is free software; you can redistribute it and/or modify
 *  it under the terms of the GNU General Public License version 2 as
 *  publishhed by the Free Software Foundation.
 */

/dts-v1/;
/plugin/;
/include/ "EMILY_LX9_V4_PHILIPPINE_overlay.dtsi"

/ {
        board_id = <6514>;
};

&rootparam {
        hisi,dtbo_idx = <44>;
    hisi,boardid = <6 5 1 4>;
    hisi,boardname = "EMILY_LX9_VN1_PHILIPPINE";
};

