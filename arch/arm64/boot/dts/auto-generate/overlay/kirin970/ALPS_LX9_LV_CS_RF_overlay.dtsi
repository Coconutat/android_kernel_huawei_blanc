
/**
 * Copyright (C) 2014 Hisilicon Ltd.
 *
 *  This program is free software; you can redistribute it and/or modify
 *  it under the terms of the GNU General Public License version 2 as
 *  publishhed by the Free Software Foundation.
 */

/include/ "ALPS_LX9_VN1_CS_G_WIFI_PMIC_overlay.dtsi"

/ {
	board_id = <6423>;
};
&rootparam {
    hisi,boardid = <6 4 2 3>;
    hisi,boardname = "ALPS_LX9_LV_CS_RF";
};

&coul_core {
	basp_mask_delay = <0>;
};
