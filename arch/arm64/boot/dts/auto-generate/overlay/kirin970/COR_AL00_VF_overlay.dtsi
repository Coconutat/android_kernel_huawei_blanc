
/**
 * Copyright (C) 2014 Hisilicon Ltd.
 *
 *  This program is free software; you can redistribute it and/or modify
 *  it under the terms of the GNU General Public License version 2 as
 *  publishhed by the Free Software Foundation.
 */

/include/ "COR_AL00_VE_overlay.dtsi"

/ {
	board_id = <6936>;
};
&rootparam {
    hisi,boardid = <6 9 3 6>;
    hisi,boardname = "COR_AL00_VF";
};
	&invert_hs {
		status = "disabled";
	};
