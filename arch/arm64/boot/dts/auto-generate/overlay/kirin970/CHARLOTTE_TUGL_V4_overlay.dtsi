
/**
 * Copyright (C) 2014 Hisilicon Ltd.
 *
 *  This program is free software; you can redistribute it and/or modify
 *  it under the terms of the GNU General Public License version 2 as
 *  publishhed by the Free Software Foundation.
 */

/include/ "CHARLOTTE_TUGL_V3_overlay.dtsi"

/ {
        board_id = <6535>;
};
&rootparam {
    hisi,boardid = <6 5 3 5>;
    hisi,boardname = "CHARLOTTE_TUGL_V4";
};

