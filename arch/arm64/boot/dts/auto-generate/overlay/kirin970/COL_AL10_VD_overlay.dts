
/**
 * Copyright (C) 2014 Hisilicon Ltd.
 *
 *  This program is free software; you can redistribute it and/or modify
 *  it under the terms of the GNU General Public License version 2 as
 *  publishhed by the Free Software Foundation.
 */

/dts-v1/;
/plugin/;
/include/ "COL_AL10_VC_overlay.dtsi"

/ {
	board_id = <6808>;
};

&rootparam {
        hisi,dtbo_idx = <8>;
    hisi,boardid = <6 8 0 8>;
    hisi,boardname = "COL_AL10_VD";
};

&antenna_board_adc_match{
	antenna_board_match_range = <1700 1875>;
	status = "ok";
};
