/*ts kit*/
&ts_kit {
	compatible = "huawei,ts_kit";
	bus_type = "i2c";
	need_i2c_hwlock = <1>;
	product = "neo";
	bus_id = <7>;
	has_virtualkey = <0>;
	fpga_flag = <0>;
	irq_gpio = <&gpio26 4 0>;
	reset_gpio = <&gpio1 7 0>;
	aft_enable = <1>;
	drv_stop_width = <0>;
	lcd_width = <0>;
	lcd_height = <0>;
	st_ts@49 {
		i2c_address = <0x49>;
		compatible = "st_ts";
		x_max = <1440>;
		y_max = <2880>;
		x_max_mt = <1440>;
		y_max_mt = <2880>;
		irq_config = <0>;
		algo_id = <1>;
		unite_cap_test_interface = <1>;
		vci_gpio_type = <0>;
		vci_regulator_type = <1>;
		vci_pmic_type = <0>;
		vddio_gpio_type = <0>;
		vddio_regulator_type = <1>;
		vddio_pmic_type = <0>;
		/* vci_ctrl_gpio = <&gpio6 4 0>; */
		/* vddio_ctrl_gpio = <&gpio8 3 0>; */
		st-io-supply = <&ldo16>;
		st-vci-supply = <&ldo9>;
		supported_func_indicater = <0x11>;
		self_cap_test_support = <0x01>;
		fake_project_id = "CURV431000";
		use_lcdkit_power_notify = <1>;
		st,forcekey_test_supported = <1>;
	};
};
