
/**
 * Copyright (C) 2014 Hisilicon Ltd.
 *
 *  This program is free software; you can redistribute it and/or modify
 *  it under the terms of the GNU General Public License version 2 as
 *  publishhed by the Free Software Foundation.
 */

/include/ "COL_AL10_VB_overlay.dtsi"

/ {
	board_id = <6806>;
};

&rootparam {
    hisi,boardid = <6 8 0 6>;
    hisi,boardname = "COL_AL10_VC";
};

