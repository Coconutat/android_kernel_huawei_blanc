
/**
 * Copyright (C) 2014 Hisilicon Ltd.
 *
 *  This program is free software; you can redistribute it and/or modify
 *  it under the terms of the GNU General Public License version 2 as
 *  publishhed by the Free Software Foundation.
 */

/dts-v1/;
/plugin/;
/include/ "COR_AL10_VB_overlay.dtsi"

/ {
	board_id = <6953>;
};
&rootparam {
        hisi,dtbo_idx = <132>;
    hisi,boardid = <6 9 5 3>;
    hisi,boardname = "COR_AL10_VC";
};

