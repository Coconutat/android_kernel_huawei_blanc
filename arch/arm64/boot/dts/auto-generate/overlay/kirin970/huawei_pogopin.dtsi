/*
 * huawei_pogopin.dtsi
 *
 * pogopin dtsi
 *
 * Copyright (c) 2012-2018 Huawei Technologies Co., Ltd.
 *
 * This software is licensed under the terms of the GNU General Public
 * License version 2, as published by the Free Software Foundation, and
 * may be copied, distributed, and modified under those terms.
 *
 * This program is distributed in the hope that it will be useful,
 * but WITHOUT ANY WARRANTY; without even the implied warranty of
 * MERCHANTABILITY or FITNESS FOR A PARTICULAR PURPOSE. See the
 * GNU General Public License for more details.
 *
 */

/{
	huawei_pogopin_charger: huawei_pogopin_charger {
		compatible = "huawei,pogopin";
		usb_switch_gpio = <&gpio27 1 0>;
		power_switch_gpio = <&gpio22 1 0>;
		switch_power_gpio = <&gpio26 0 0>;
		typec_int_gpio = <&gpio29 0 0>;
		pogopin_int_gpio =<&gpio29 1 0>;
		buck_boost_gpio = <&gpio26 7 0>;
		pin_num = <0>; /* 0 - 3pin, 1 - 5pin */
		status = "disable";
	};

	pogopin_buckboost: pogopin_buckboost {
		compatible = "huawei,vbus_channel_pogopin_boost";
		vbus_mos_ctrl_gpio = <&gpio16 7 0>;
		buckboost_gpio = <&gpio17 0 0>;
		status = "disable";
	};

	pogopin_otg_by_id {
		compatible = "huawei,pogopin-otg-by-id";
		otg_adc_channel = <7>;
		otg-gpio = <&gpio27 0 0>;
		sampling_time_optimize = <0>;
		status = "disable";
	};

};
