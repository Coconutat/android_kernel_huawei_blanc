
/**
 * Copyright (C) 2014 Hisilicon Ltd.
 *
 *  This program is free software; you can redistribute it and/or modify
 *  it under the terms of the GNU General Public License version 2 as
 *  publishhed by the Free Software Foundation.
 */

/include/ "BLANC_BA09_LX9_V3_DE_overlay.dtsi"

/ {
	board_id = <6473>;
};

&rootparam {
    hisi,boardid = <6 4 7 3>;
    hisi,boardname = "BLANC_BA09_LX9_V4";
};

