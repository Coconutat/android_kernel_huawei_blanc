
/**
 * Copyright (C) 2014 Hisilicon Ltd.
 *
 *  This program is free software; you can redistribute it and/or modify
 *  it under the terms of the GNU General Public License version 2 as
 *  publishhed by the Free Software Foundation.
 */

/dts-v1/;
/plugin/;
/include/ "CHARLOTTE_CAN_V1_overlay.dtsi"
/include/ "CHARLOTTE_CAN_V2_overlay_module_amba.dts"

/ {
        board_id = <6532>;
};

&rootparam {
        hisi,dtbo_idx = <175>;
    hisi,boardid = <6 5 3 2>;
    hisi,boardname = "CHARLOTTE_CAN_V2";
};


&dp_aux_switch {
    aux_switch_from_fsa4476;
    status = "ok";
};
&direct_charger {
	min_dc_bat_vol = <3550>;
};
