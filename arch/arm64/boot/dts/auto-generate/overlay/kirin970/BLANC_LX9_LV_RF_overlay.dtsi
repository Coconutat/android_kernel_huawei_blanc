
/**
 * Copyright (C) 2014 Hisilicon Ltd.
 *
 *  This program is free software; you can redistribute it and/or modify
 *  it under the terms of the GNU General Public License version 2 as
 *  publishhed by the Free Software Foundation.
 */

/include/ "BLANC_LX9_VN1_ANTI_overlay.dtsi"

/ {
	board_id = <6460>;
};

&rootparam {
    hisi,boardid = <6 4 6 0>;
    hisi,boardname = "BLANC_LX9_LV_RF";
};

