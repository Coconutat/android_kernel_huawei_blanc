
/**
 * Copyright (C) 2014 Hisilicon Ltd.
 *
 *  This program is free software; you can redistribute it and/or modify
 *  it under the terms of the GNU General Public License version 2 as
 *  publishhed by the Free Software Foundation.
 */

/dts-v1/;
/plugin/;
/include/ "NEO_TUGL_V1_overlay.dtsi"

/ {
        board_id = <6483>;
};

&rootparam {
        hisi,dtbo_idx = <37>;
    hisi,boardid = <6 4 8 3>;
    hisi,boardname = "NEO_TUGL_V2";
};


