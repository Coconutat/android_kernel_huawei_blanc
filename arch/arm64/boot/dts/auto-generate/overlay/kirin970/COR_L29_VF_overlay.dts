
/**
 * Copyright (C) 2014 Hisilicon Ltd.
 *
 *  This program is free software; you can redistribute it and/or modify
 *  it under the terms of the GNU General Public License version 2 as
 *  publishhed by the Free Software Foundation.
 */

/dts-v1/;
/plugin/;
/include/ "COR_L29_VE_overlay.dtsi"

/ {
	board_id = <6941>;
};
&rootparam {
        hisi,dtbo_idx = <26>;
    hisi,boardid = <6 9 4 1>;
    hisi,boardname = "COR_L29_VF";
};
	&invert_hs {
		status = "disabled";
	};