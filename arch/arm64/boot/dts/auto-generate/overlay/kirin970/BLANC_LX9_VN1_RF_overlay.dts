
/**
 * Copyright (C) 2014 Hisilicon Ltd.
 *
 *  This program is free software; you can redistribute it and/or modify
 *  it under the terms of the GNU General Public License version 2 as
 *  publishhed by the Free Software Foundation.
 */

/dts-v1/;
/plugin/;
/include/ "BLANC_LX9_V3_9688_overlay.dtsi"

/ {
	board_id = <6455>;
};

&rootparam {
        hisi,dtbo_idx = <50>;
    hisi,boardid = <6 4 5 5>;
    hisi,boardname = "BLANC_LX9_VN1_RF";
};

