
/**
 * Copyright (C) 2014 Hisilicon Ltd.
 *
 *  This program is free software; you can redistribute it and/or modify
 *  it under the terms of the GNU General Public License version 2 as
 *  publishhed by the Free Software Foundation.
 */

/dts-v1/;
/plugin/;
/include/ "PAR_LX9_VB_overlay.dtsi"

/ {
	board_id = <6843>;
};
&rootparam {
        hisi,dtbo_idx = <136>;
    hisi,boardid = <6 8 4 3>;
    hisi,boardname = "PAR_LX9_VC";
};

