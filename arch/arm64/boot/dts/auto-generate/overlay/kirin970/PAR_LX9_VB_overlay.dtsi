
/**
 * Copyright (C) 2014 Hisilicon Ltd.
 *
 *  This program is free software; you can redistribute it and/or modify
 *  it under the terms of the GNU General Public License version 2 as
 *  publishhed by the Free Software Foundation.
 */

/include/ "PAR_LX9_VA_overlay.dtsi"

/ {
	board_id = <6842>;
};

&rootparam {
    hisi,boardid = <6 8 4 2>;
    hisi,boardname = "PAR_LX9_VB";
};

&deviceboxID {
	speaker_map = <1 3>;/*3 means GD, 1 means AAC*/
};
