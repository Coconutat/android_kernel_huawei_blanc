
/**
 * Copyright (C) 2014 Hisilicon Ltd.
 *
 *  This program is free software; you can redistribute it and/or modify
 *  it under the terms of the GNU General Public License version 2 as
 *  publishhed by the Free Software Foundation.
 */

/include/ "NEO_TUGL_V2_FP_config.dtsi"

/ {
	hisi,boardid = <6 4 8 6>;
	hisi,boardname = "NEO_TUGL_V3_FP";
	hisi,modem_id = <0x39040C00>;
	hisi,product_id = <0x39040C00>;
	hisi,product_name = "NEO-AL00";
};
