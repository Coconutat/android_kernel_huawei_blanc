
/**
 * Copyright (C) 2014 Hisilicon Ltd.
 *
 *  This program is free software; you can redistribute it and/or modify
 *  it under the terms of the GNU General Public License version 2 as
 *  publishhed by the Free Software Foundation.
 */

/dts-v1/;
/include/ "fastboot.dtsi"
/include/ "VCE_AL00_VA_config.dtsi"
/include/ "VCE_AL00_VB_pin.dtsi"
/include/ "VCE_AL00_VB_sec_pin.dtsi"
/include/ "VCE_AL00_VB_modem_pin.dtsi"

/ {
	hisi,boardid = <6 9 7 2>;
	hisi,boardname = "VCE_AL00_VB";
	hisi,modem_id = <0X39650C00>;
};
