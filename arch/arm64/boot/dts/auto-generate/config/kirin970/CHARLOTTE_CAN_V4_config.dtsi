
/**
 * Copyright (C) 2014 Hisilicon Ltd.
 *
 *  This program is free software; you can redistribute it and/or modify
 *  it under the terms of the GNU General Public License version 2 as
 *  publishhed by the Free Software Foundation.
 */

/include/ "CHARLOTTE_CAN_V3_config.dtsi"

/ {
	hisi,boardid = <6 5 4 3>;
	hisi,boardname = "CHARLOTTE_CAN_V4";
	hisi,product_id = <0x3903BC00>;
	hisi,modem_id = <0x3903BC00>;
	hisi,product_name = "CLT-L04";
};
