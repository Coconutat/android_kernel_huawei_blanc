
/**
 * Copyright (C) 2014 Hisilicon Ltd.
 *
 *  This program is free software; you can redistribute it and/or modify
 *  it under the terms of the GNU General Public License version 2 as
 *  publishhed by the Free Software Foundation.
 */

/dts-v1/;
/include/ "fastboot.dtsi"
/include/ "VCE_TL00_VE_config.dtsi"
/include/ "VCE_TL00_VF_pin.dtsi"
/include/ "VCE_TL00_VF_sec_pin.dtsi"
/include/ "VCE_TL00_VF_modem_pin.dtsi"

/ {
	hisi,boardid = <6 9 8 3>;
	hisi,boardname = "VCE_TL00_VF";
	hisi,modem_id = <0X39651800>;
	hisi,product_name = "VCE-TL00";
};
