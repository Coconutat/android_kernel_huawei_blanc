
/**
 * Copyright (C) 2014 Hisilicon Ltd.
 *
 *  This program is free software; you can redistribute it and/or modify
 *  it under the terms of the GNU General Public License version 2 as
 *  publishhed by the Free Software Foundation.
 */

/dts-v1/;
/include/ "fastboot.dtsi"
/include/ "VCE_AL00_VD_config.dtsi"
/include/ "VCE_AL00_VE_pin.dtsi"
/include/ "VCE_AL00_VE_sec_pin.dtsi"
/include/ "VCE_AL00_VE_modem_pin.dtsi"

/ {
	hisi,boardid = <6 9 8 1>;
	hisi,boardname = "VCE_AL00_VE";
	hisi,modem_id = <0X39651400>;
};
