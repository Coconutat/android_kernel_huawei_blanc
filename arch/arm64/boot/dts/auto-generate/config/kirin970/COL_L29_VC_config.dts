
/**
 * Copyright (C) 2014 Hisilicon Ltd.
 *
 *  This program is free software; you can redistribute it and/or modify
 *  it under the terms of the GNU General Public License version 2 as
 *  publishhed by the Free Software Foundation.
 */

/dts-v1/;
/include/ "fastboot.dtsi"
/include/ "COL_L29_VB_config.dtsi"
/include/ "COL_L29_VC_pin.dtsi"
/include/ "COL_L29_VC_sec_pin.dtsi"
/include/ "COL_L29_VC_modem_pin.dtsi"

/ {
	hisi,boardid = <6 8 2 3>;
	hisi,boardname = "COL_L29_VC";
	hisi,modem_id = <0x39614C00>;
};
