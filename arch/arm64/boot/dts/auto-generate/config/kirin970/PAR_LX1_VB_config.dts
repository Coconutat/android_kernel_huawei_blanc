
/**
 * Copyright (C) 2014 Hisilicon Ltd.
 *
 *  This program is free software; you can redistribute it and/or modify
 *  it under the terms of the GNU General Public License version 2 as
 *  publishhed by the Free Software Foundation.
 */

/dts-v1/;
/include/ "fastboot.dtsi"
/include/ "PAR_LX1_VA_config.dtsi"
/include/ "PAR_LX1_VB_pin.dtsi"
/include/ "PAR_LX1_VB_sec_pin.dtsi"
/include/ "PAR_LX1_VB_modem_pin.dtsi"

/ {
	hisi,boardid = <6 8 6 2>;
	hisi,boardname = "PAR_LX1_VB";
	hisi,modem_id = <0x39633400>;
};
