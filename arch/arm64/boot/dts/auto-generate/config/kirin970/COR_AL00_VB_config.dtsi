
/**
 * Copyright (C) 2014 Hisilicon Ltd.
 *
 *  This program is free software; you can redistribute it and/or modify
 *  it under the terms of the GNU General Public License version 2 as
 *  publishhed by the Free Software Foundation.
 */

/include/ "COR_AL00_VA_config.dtsi"

/ {
	hisi,boardid = <6 9 3 2>;
	hisi,boardname = "COR_AL00_VB";
	hisi,modem_id = <0x39640800>;
};
