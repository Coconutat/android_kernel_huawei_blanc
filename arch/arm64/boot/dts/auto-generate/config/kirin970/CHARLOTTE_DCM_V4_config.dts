
/**
 * Copyright (C) 2014 Hisilicon Ltd.
 *
 *  This program is free software; you can redistribute it and/or modify
 *  it under the terms of the GNU General Public License version 2 as
 *  publishhed by the Free Software Foundation.
 */

/dts-v1/;
/include/ "fastboot.dtsi"
/include/ "CHARLOTTE_DCM_V3_config.dtsi"
/include/ "CHARLOTTE_DCM_V4_pin.dtsi"
/include/ "CHARLOTTE_DCM_V4_sec_pin.dtsi"
/include/ "CHARLOTTE_DCM_V4_modem_pin.dtsi"

/ {
	hisi,boardid = <6 5 4 4>;
	hisi,boardname = "CHARLOTTE_DCM_V4";
	hisi,product_id = <0x3903C800>;
	hisi,modem_id = <0x3903C800>;
	hisi,product_name = "CLT-L0J";
};
