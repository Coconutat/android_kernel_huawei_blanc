
/**
 * Copyright (C) 2014 Hisilicon Ltd.
 *
 *  This program is free software; you can redistribute it and/or modify
 *  it under the terms of the GNU General Public License version 2 as
 *  publishhed by the Free Software Foundation.
 */

/dts-v1/;
/include/ "fastboot.dtsi"
/include/ "BKL_TL10_V4_config.dtsi"
/include/ "BKL_TL10_VN1_pin.dtsi"
/include/ "BKL_TL10_VN1_sec_pin.dtsi"
/include/ "BKL_TL10_VN1_modem_pin.dtsi"

/ {
	hisi,boardid = <6 9 1 4>;
	hisi,boardname = "BKL_TL10_VN1";
	hisi,modem_id = <0x39604C00>;
};