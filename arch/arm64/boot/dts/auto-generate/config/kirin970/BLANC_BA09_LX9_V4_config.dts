
/**
 * Copyright (C) 2014 Hisilicon Ltd.
 *
 *  This program is free software; you can redistribute it and/or modify
 *  it under the terms of the GNU General Public License version 2 as
 *  publishhed by the Free Software Foundation.
 */

/dts-v1/;
/include/ "fastboot.dtsi"
/include/ "BLANC_BA09_LX9_V3_DE_config.dtsi"
/include/ "BLANC_BA09_LX9_V4_pin.dtsi"
/include/ "BLANC_BA09_LX9_V4_sec_pin.dtsi"
/include/ "BLANC_BA09_LX9_V4_modem_pin.dtsi"

/ {
	hisi,boardid = <6 4 7 3>;
	hisi,boardname = "BLANC_BA09_LX9_V4";
	hisi,product_id = <0x3901B000>;
	hisi,modem_id = <0x3901B000>;
};
