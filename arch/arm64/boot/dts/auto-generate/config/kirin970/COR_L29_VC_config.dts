
/**
 * Copyright (C) 2014 Hisilicon Ltd.
 *
 *  This program is free software; you can redistribute it and/or modify
 *  it under the terms of the GNU General Public License version 2 as
 *  publishhed by the Free Software Foundation.
 */

/dts-v1/;
/include/ "fastboot.dtsi"
/include/ "huawei_antenna_board_match.dtsi"
/include/ "COR_L29_VB_config.dtsi"
/include/ "COR_L29_VC_pin.dtsi"
/include/ "COR_L29_VC_sec_pin.dtsi"
/include/ "COR_L29_VC_modem_pin.dtsi"

/ {
	hisi,boardid = <6 9 5 5>;
	hisi,boardname = "COR_L29_VC";
	hisi,modem_id = <0x39644000>;
	hisi,product_name = "COR-L29";

	hw_antenna_board_match:hw_antenna_board_match{
		status = "ok";
	};
	antenna_board_adc_match:antenna_board_adc_match{
		status = "ok";
	};
};
