
/**
 * Copyright (C) 2014 Hisilicon Ltd.
 *
 *  This program is free software; you can redistribute it and/or modify
 *  it under the terms of the GNU General Public License version 2 as
 *  publishhed by the Free Software Foundation.
 */

/include/ "lcdkit/par_vn1/devkit_lcd.dtsi"
/include/ "PAR_TL20_VB_config.dtsi"

/ {
	hisi,boardid = <6 8 8 3>;
	hisi,boardname = "PAR_TL20_VC";
	hisi,modem_id = <0x39634400>;
	huawei_lcd_panel: huawei,lcd_panel {
		product_id = <8001>;
	};
};
