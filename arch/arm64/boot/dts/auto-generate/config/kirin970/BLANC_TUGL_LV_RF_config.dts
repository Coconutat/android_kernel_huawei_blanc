
/**
 * Copyright (C) 2014 Hisilicon Ltd.
 *
 *  This program is free software; you can redistribute it and/or modify
 *  it under the terms of the GNU General Public License version 2 as
 *  publishhed by the Free Software Foundation.
 */

/dts-v1/;
/include/ "fastboot.dtsi"
/include/ "BLANC_TUGL_VN1_ANTI_config.dtsi"
/include/ "BLANC_TUGL_LV_RF_pin.dtsi"
/include/ "BLANC_TUGL_LV_RF_sec_pin.dtsi"
/include/ "BLANC_TUGL_LV_RF_modem_pin.dtsi"
/include/ "huawei_cc_anti_corrosion.dtsi"
/ {
	hisi,boardid = <6 4 6 1>;
	hisi,boardname = "BLANC_TUGL_LV_RF";
	hisi,product_id = <0x39012400>;
	hisi,modem_id = <0x39012400>;
};
