
/**
 * Copyright (C) 2014 Hisilicon Ltd.
 *
 *  This program is free software; you can redistribute it and/or modify
 *  it under the terms of the GNU General Public License version 2 as
 *  publishhed by the Free Software Foundation.
 */

/dts-v1/;
/include/ "fastboot.dtsi"
/include/ "huawei_cc_anti_corrosion.dtsi"
/include/ "EMILY_LX9_V3_config.dtsi"
/include/ "EMILY_LX9_V4_pin.dtsi"
/include/ "EMILY_LX9_V4_modem_pin.dtsi"

/ {
	hisi,boardid = <6 5 1 0>;
	hisi,boardname = "EMILY_LX9_V4";
	hisi,product_id = <0x39022800>;
	hisi,modem_id = <0x39022800>;
	hisi,product_name = "EMILY-LX9";

	cc_anti_corrosion: cc_anti_corrosion {
		status = "disabled";
	};
};
