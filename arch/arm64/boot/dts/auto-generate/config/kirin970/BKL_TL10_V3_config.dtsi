
/**
 * Copyright (C) 2014 Hisilicon Ltd.
 *
 *  This program is free software; you can redistribute it and/or modify
 *  it under the terms of the GNU General Public License version 2 as
 *  publishhed by the Free Software Foundation.
 */

/include/ "BKL_AL00_V1_config.dtsi"

/ {
	hisi,boardid = <6 9 0 5>;
	hisi,boardname = "BKL_TL10_V3";
	hisi,modem_id = <0x39602000>;
	hisi,product_name = "BKL-TL10";
};
