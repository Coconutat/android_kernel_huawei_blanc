
/**
 * Copyright (C) 2014 Hisilicon Ltd.
 *
 *  This program is free software; you can redistribute it and/or modify
 *  it under the terms of the GNU General Public License version 2 as
 *  publishhed by the Free Software Foundation.
 */

/dts-v1/;
/include/ "fastboot.dtsi"
/include/ "EMILY_LX9_V3_config.dtsi"
/include/ "EMILY_LX9_V3_PHILIPPINE_pin.dtsi"
/include/ "EMILY_LX9_V3_PHILIPPINE_sec_pin.dtsi"
/include/ "EMILY_LX9_V3_PHILIPPINE_modem_pin.dtsi"

/ {
	hisi,boardid = <6 5 0 8>;
	hisi,boardname = "EMILY_LX9_V3_PHILIPPINE";
	hisi,product_id = <0x39022000>;
	hisi,modem_id = <0x39022000>;
	hisi,product_name = "EMILY-LX9";
};
