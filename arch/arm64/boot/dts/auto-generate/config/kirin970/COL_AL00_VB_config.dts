
/**
 * Copyright (C) 2014 Hisilicon Ltd.
 *
 *  This program is free software; you can redistribute it and/or modify
 *  it under the terms of the GNU General Public License version 2 as
 *  publishhed by the Free Software Foundation.
 */

/dts-v1/;
/include/ "fastboot.dtsi"
/include/ "COL_AL00_VA_config.dtsi"
/include/ "COL_AL00_VB_pin.dtsi"
/include/ "COL_AL00_VB_sec_pin.dtsi"
/include/ "COL_AL00_VB_modem_pin.dtsi"

/ {
	hisi,boardid = <6 8 0 3>;
	hisi,boardname = "COL_AL00_VB";
	hisi,modem_id = <0x39612800>;

	amba: amba {
		i2c3: i2c@FDF0C000 {
			pn547_nfc: nfc@28 {
				nfc_brcm_conf_name = "libnfc-brcm.conf";
				nfc_nxp_name = "libnfc-nxp.conf";
				nfc_card_num = <0x2>;
				nfc_chip_type = "pn551";
			};
		};
	};
};
