
/**
 * Copyright (C) 2014 Hisilicon Ltd.
 *
 *  This program is free software; you can redistribute it and/or modify
 *  it under the terms of the GNU General Public License version 2 as
 *  publishhed by the Free Software Foundation.
 */

/include/ "huawei_antenna_board_match.dtsi"
/include/ "COL_AL10_VC_config.dtsi"

/ {
	hisi,boardid = <6 8 0 8>;
	hisi,boardname = "COL_AL10_VD";
	hisi,modem_id = <0x39615400>;
};
