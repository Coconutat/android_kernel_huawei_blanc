
/**
 * Copyright (C) 2014 Hisilicon Ltd.
 *
 *  This program is free software; you can redistribute it and/or modify
 *  it under the terms of the GNU General Public License version 2 as
 *  publishhed by the Free Software Foundation.
 */

/dts-v1/;
/include/ "fastboot.dtsi"
/include/ "CHARLOTTE_DCM_V1_config.dtsi"
/include/ "CHARLOTTE_DCM_V2_pin.dtsi"
/include/ "CHARLOTTE_DCM_V2_sec_pin.dtsi"
/include/ "CHARLOTTE_DCM_V2_modem_pin.dtsi"

/ {
	hisi,boardid = <6 5 3 3>;
	hisi,boardname = "CHARLOTTE_DCM_V2";
	hisi,product_id = <0x3903A000>;
	hisi,modem_id = <0x3903A000>;
	hisi,product_name = "CLT-L0J";
};
