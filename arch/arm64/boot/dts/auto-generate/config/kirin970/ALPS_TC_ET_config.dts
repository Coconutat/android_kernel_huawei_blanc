
/**
 * Copyright (C) 2014 Hisilicon Ltd.
 *
 *  This program is free software; you can redistribute it and/or modify
 *  it under the terms of the GNU General Public License version 2 as
 *  publishhed by the Free Software Foundation.
 */

/dts-v1/;
/include/ "fastboot.dtsi"
/include/ "ALPS_TUGL_V1_config.dtsi"
/include/ "ALPS_TC_ET_pin.dtsi"
/include/ "ALPS_TC_ET_sec_pin.dtsi"

/ {
	hisi,boardid = <6 4 0 2>;
	hisi,boardname = "ALPS_TC_ET";
	hisi,product_id = <0x39000400>;
	hisi,modem_id = <0x39000400>;
};
