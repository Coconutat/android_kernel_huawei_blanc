
/**
 * Copyright (C) 2014 Hisilicon Ltd.
 *
 *  This program is free software; you can redistribute it and/or modify
 *  it under the terms of the GNU General Public License version 2 as
 *  publishhed by the Free Software Foundation.
 */

/include/ "CHARLOTTE_DCM_VN1_config.dtsi"

/ {
	hisi,boardid = <6 5 4 9>;
	hisi,boardname = "CHARLOTTE_DCM_VF";
	hisi,product_id = <0x3903F000>;
	hisi,modem_id = <0x3903F000>;
	hisi,product_name = "CLT-L0J";
};
