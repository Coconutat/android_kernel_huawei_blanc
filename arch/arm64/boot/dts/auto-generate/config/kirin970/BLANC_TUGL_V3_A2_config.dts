
/**
 * Copyright (C) 2014 Hisilicon Ltd.
 *
 *  This program is free software; you can redistribute it and/or modify
 *  it under the terms of the GNU General Public License version 2 as
 *  publishhed by the Free Software Foundation.
 */

/dts-v1/;
/include/ "fastboot.dtsi"
/include/ "BLANC_TUGL_V1_config.dtsi"
/include/ "BLANC_TUGL_V3_A2_pin.dtsi"
/include/ "BLANC_TUGL_V3_A2_sec_pin.dtsi"
/include/ "BLANC_TUGL_V3_A2_modem_pin.dtsi"

/ {
	hisi,boardid = <6 4 5 2>;
	hisi,boardname = "BLANC_TUGL_V3_A2";
	hisi,product_id = <0x39010800>;
	hisi,modem_id = <0x39010800>;
	sensorhub{
		rpc_sensor:rpc{
			rpc{
				compatible = "huawei,rpc";
				file_id = <0x18>;
				sensor_list_info_id = <24>;
				sensor_type = "rpc";
				sensorlist_name = "rpc";
				mask = <0xFFFF 0x630 0x630 0x630 0x200 0xFFFF 0xFFFF 0xFFFF
					0xFFFF 0xFFFF 0xFFFF 0xFFFF 0xFFFF 0xFFFF 0xFFFF 0xFFFF
					0xFFFF 0xFFFF 0xFFFF 0xFFFF 0xFFFF 0xFFFF 0xFFFF 0xFFFF
					0xFFFF 0xFFFF 0xFFFF 0xFFFF 0xFFFF 0xFFFF 0xFFFF 0xFFFF>;
				table = <0xFFFF 0x210 0x220 0x200 0x0 0xFFFF 0xFFFF 0xFFFF
					 0xFFFF 0xFFFF 0xFFFF 0xFFFF 0xFFFF 0xFFFF 0xFFFF 0xFFFF
					 0xFFFF 0xFFFF 0xFFFF 0xFFFF 0xFFFF 0xFFFF 0xFFFF 0xFFFF
					 0xFFFF 0xFFFF 0xFFFF 0xFFFF 0xFFFF 0xFFFF 0xFFFF 0xFFFF>;
				default_value = <0x1D>;
				status = "ok";
			};
	        };
	};
};
