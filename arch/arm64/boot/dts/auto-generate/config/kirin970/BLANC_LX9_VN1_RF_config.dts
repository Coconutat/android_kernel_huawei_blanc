
/**
 * Copyright (C) 2014 Hisilicon Ltd.
 *
 *  This program is free software; you can redistribute it and/or modify
 *  it under the terms of the GNU General Public License version 2 as
 *  publishhed by the Free Software Foundation.
 */

/dts-v1/;
/include/ "fastboot.dtsi"
/include/ "BLANC_LX9_V3_9688_config.dtsi"
/include/ "BLANC_LX9_VN1_RF_pin.dtsi"
/include/ "BLANC_LX9_VN1_RF_sec_pin.dtsi"
/include/ "BLANC_LX9_VN1_RF_modem_pin.dtsi"

/ {
	hisi,boardid = <6 4 5 5>;
	hisi,boardname = "BLANC_LX9_VN1_RF";
	hisi,product_id = <0x39012000>;
	hisi,modem_id = <0x39012000>;
};
