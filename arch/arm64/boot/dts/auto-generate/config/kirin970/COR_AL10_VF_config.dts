
/**
 * Copyright (C) 2014 Hisilicon Ltd.
 *
 *  This program is free software; you can redistribute it and/or modify
 *  it under the terms of the GNU General Public License version 2 as
 *  publishhed by the Free Software Foundation.
 */

/dts-v1/;
/include/ "fastboot.dtsi"
/include/ "COR_AL10_VE_config.dtsi"
/include/ "COR_AL10_VF_pin.dtsi"
/include/ "COR_AL10_VF_sec_pin.dtsi"
/include/ "COR_AL10_VF_modem_pin.dtsi"

/ {
	hisi,boardid = <6 9 3 7>;
	hisi,boardname = "COR_AL10_VF";
	hisi,modem_id = <0x39645000>;
	hisi,product_name = "COR-AL10";
};
