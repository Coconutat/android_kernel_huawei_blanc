
/**
 * Copyright (C) 2014 Hisilicon Ltd.
 *
 *  This program is free software; you can redistribute it and/or modify
 *  it under the terms of the GNU General Public License version 2 as
 *  publishhed by the Free Software Foundation.
 */

/include/ "BLANC_TUGL_LV_RF_config.dtsi"
/include/ "huawei_cc_anti_corrosion.dtsi"
/ {
	hisi,boardid = <6 4 6 3>;
	hisi,boardname = "BLANC_TUGL_LV_9688";
	hisi,product_id = <0x39011C00>;
	hisi,modem_id = <0x39011C00>;
};
