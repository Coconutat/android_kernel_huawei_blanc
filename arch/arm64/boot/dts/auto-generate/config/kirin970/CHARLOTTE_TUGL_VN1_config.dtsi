
/**
 * Copyright (C) 2014 Hisilicon Ltd.
 *
 *  This program is free software; you can redistribute it and/or modify
 *  it under the terms of the GNU General Public License version 2 as
 *  publishhed by the Free Software Foundation.
 */

/include/ "CHARLOTTE_TUGL_V4_config.dtsi"

/ {
	hisi,boardid = <6 5 4 0>;
	hisi,boardname = "CHARLOTTE_TUGL_VN1";
	hisi,product_id = <0x39034000>;
	hisi,modem_id = <0x39034000>;
	hisi,product_name = "CLT-AL00";
};
