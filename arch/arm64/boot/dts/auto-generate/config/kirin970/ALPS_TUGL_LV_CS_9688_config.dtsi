
/**
 * Copyright (C) 2014 Hisilicon Ltd.
 *
 *  This program is free software; you can redistribute it and/or modify
 *  it under the terms of the GNU General Public License version 2 as
 *  publishhed by the Free Software Foundation.
 */

/include/ "ALPS_TUGL_LV_CS_RF_config.dtsi"

/ {
	hisi,boardid = <6 4 2 6>;
	hisi,boardname = "ALPS_TUGL_LV_CS_9688";
	hisi,product_id = <0x39005400>;
	hisi,modem_id = <0x39005400>;
};
