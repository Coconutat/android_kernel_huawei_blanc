
/**
 * Copyright (C) 2014 Hisilicon Ltd.
 *
 *  This program is free software; you can redistribute it and/or modify
 *  it under the terms of the GNU General Public License version 2 as
 *  publishhed by the Free Software Foundation.
 */

/include/ "COL_AL00_VA_config.dtsi"

/ {
	hisi,boardid = <6 8 2 1>;
	hisi,boardname = "COL_L29_VA";
	hisi,modem_id = <0x39611000>;
	hisi,product_name = "COL-L29";

	/*hisi connectivity customize*/
	hisi_cust_cfg {
		compatible = "hi1102,customize";
		ini_file_name = "/vendor/etc/cfg_col_lx9_hisi.ini";
	};
	hall{
		status = "ok";
	};
};