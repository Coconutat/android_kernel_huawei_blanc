
/**
 * Copyright (C) 2014 Hisilicon Ltd.
 *
 *  This program is free software; you can redistribute it and/or modify
 *  it under the terms of the GNU General Public License version 2 as
 *  publishhed by the Free Software Foundation.
 */

/include/ "BLANC_LX9_LV_RF_config.dtsi"
/include/ "huawei_cc_anti_corrosion.dtsi"
/ {
	hisi,boardid = <6 4 6 2>;
	hisi,boardname = "BLANC_LX9_LV_9688";
	hisi,product_id = <0x39012000>;
	hisi,modem_id = <0x39012000>;
};
