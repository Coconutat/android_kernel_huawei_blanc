
/**
 * Copyright (C) 2014 Hisilicon Ltd.
 *
 *  This program is free software; you can redistribute it and/or modify
 *  it under the terms of the GNU General Public License version 2 as
 *  publishhed by the Free Software Foundation.
 */

/dts-v1/;
/include/ "fastboot.dtsi"
/include/ "CHARLOTTE_TUGL_V4_config.dtsi"
/include/ "CHARLOTTE_PHA_TUGL_VN1_pin.dtsi"
/include/ "CHARLOTTE_PHA_TUGL_VN1_sec_pin.dtsi"
/include/ "CHARLOTTE_PHA_TUGL_VN1_modem_pin.dtsi"

/ {
	hisi,boardid = <6 5 4 1>;
	hisi,boardname = "CHARLOTTE_PHA_TUGL_VN1";
	hisi,product_id = <0x39050400>;
	hisi,modem_id = <0x39050400>;
	hisi,product_name = "CLT-AL01";
};
