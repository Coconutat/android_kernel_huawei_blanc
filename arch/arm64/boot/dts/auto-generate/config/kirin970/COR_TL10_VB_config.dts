
/**
 * Copyright (C) 2014 Hisilicon Ltd.
 *
 *  This program is free software; you can redistribute it and/or modify
 *  it under the terms of the GNU General Public License version 2 as
 *  publishhed by the Free Software Foundation.
 */

/dts-v1/;
/include/ "fastboot.dtsi"
/include/ "COR_AL00_VA_config.dtsi"
/include/ "COR_TL10_VB_pin.dtsi"
/include/ "COR_TL10_VB_sec_pin.dtsi"
/include/ "COR_TL10_VB_modem_pin.dtsi"

/ {
	hisi,boardid = <6 9 3 4>;
	hisi,boardname = "COR_TL10_VB";
	hisi,modem_id = <0x39640C00>;
	hisi,product_name = "COR-TL10";
};
