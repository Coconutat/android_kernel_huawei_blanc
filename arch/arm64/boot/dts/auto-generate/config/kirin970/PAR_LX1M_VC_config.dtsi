
/**
 * Copyright (C) 2014 Hisilicon Ltd.
 *
 *  This program is free software; you can redistribute it and/or modify
 *  it under the terms of the GNU General Public License version 2 as
 *  publishhed by the Free Software Foundation.
 */

/include/ "lcdkit/par_vn1/devkit_lcd.dtsi"
/include/ "PAR_LX1M_VB_config.dtsi"

/ {
	hisi,boardid = <6 8 9 3>;
	hisi,boardname = "PAR_LX1M_VC";
	hisi,modem_id = <0x39636C00>;
	huawei_lcd_panel: huawei,lcd_panel {
		product_id = <8001>;
	};
};
