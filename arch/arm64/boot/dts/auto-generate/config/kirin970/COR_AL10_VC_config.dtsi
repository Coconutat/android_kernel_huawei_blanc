
/**
 * Copyright (C) 2014 Hisilicon Ltd.
 *
 *  This program is free software; you can redistribute it and/or modify
 *  it under the terms of the GNU General Public License version 2 as
 *  publishhed by the Free Software Foundation.
 */

/include/ "huawei_antenna_board_match.dtsi"
/include/ "COR_AL10_VB_config.dtsi"

/ {
	hisi,boardid = <6 9 5 3>;
	hisi,boardname = "COR_AL10_VC";
	hisi,modem_id = <0x39643000>;
	hisi,product_name = "COR-AL10";

	hw_antenna_board_match:hw_antenna_board_match{
		status = "ok";
	};
	antenna_board_adc_match:antenna_board_adc_match{
		status = "ok";
	};
};
