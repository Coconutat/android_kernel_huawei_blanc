
/**
 * Copyright (C) 2014 Hisilicon Ltd.
 *
 *  This program is free software; you can redistribute it and/or modify
 *  it under the terms of the GNU General Public License version 2 as
 *  publishhed by the Free Software Foundation.
 */

/dts-v1/;
/include/ "fastboot.dtsi"
/include/ "lcdkit/cor_vn1/devkit_lcd.dtsi"
/include/ "COR_L29_VC_config.dtsi"
/include/ "COR_L29_VD_pin.dtsi"
/include/ "COR_L29_VD_sec_pin.dtsi"
/include/ "COR_L29_VD_modem_pin.dtsi"

/ {
	hisi,boardid = <6 9 6 5>;
	hisi,boardname = "COR_L29_VD";
	hisi,modem_id = <0x39644400>;
	hisi,product_name = "COR-L29";
	huawei_lcd_panel: huawei,lcd_panel {
		product_id = <9001>;
	};
};
