
/**
 * Copyright (C) 2014 Hisilicon Ltd.
 *
 *  This program is free software; you can redistribute it and/or modify
 *  it under the terms of the GNU General Public License version 2 as
 *  publishhed by the Free Software Foundation.
 */

/include/ "CHARLOTTE_LX9_V3_config.dtsi"

/ {
	hisi,boardid = <6 5 3 6>;
	hisi,boardname = "CHARLOTTE_LX9_V4";
	hisi,product_id = <0x39034400>;
	hisi,modem_id = <0x39034400>;
	hisi,product_name = "CHARLOTTE-LX9";
};
