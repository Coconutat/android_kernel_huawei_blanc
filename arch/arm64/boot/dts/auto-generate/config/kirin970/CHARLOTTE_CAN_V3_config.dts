
/**
 * Copyright (C) 2014 Hisilicon Ltd.
 *
 *  This program is free software; you can redistribute it and/or modify
 *  it under the terms of the GNU General Public License version 2 as
 *  publishhed by the Free Software Foundation.
 */

/dts-v1/;
/include/ "fastboot.dtsi"
/include/ "CHARLOTTE_CAN_V2_config.dtsi"
/include/ "CHARLOTTE_CAN_V3_pin.dtsi"
/include/ "CHARLOTTE_CAN_V3_sec_pin.dtsi"
/include/ "CHARLOTTE_CAN_V3_modem_pin.dtsi"

/ {
	hisi,boardid = <6 5 3 7>;
	hisi,boardname = "CHARLOTTE_CAN_V3";
	hisi,product_id = <0x3903BC00>;
	hisi,modem_id = <0x3903BC00>;
	hisi,product_name = "CLT-L04";
};
