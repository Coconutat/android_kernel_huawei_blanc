
/**
 * Copyright (C) 2014 Hisilicon Ltd.
 *
 *  This program is free software; you can redistribute it and/or modify
 *  it under the terms of the GNU General Public License version 2 as
 *  publishhed by the Free Software Foundation.
 */

/include/ "VCE_TL00_VD_config.dtsi"

/ {
	hisi,boardid = <6 9 8 2>;
	hisi,boardname = "VCE_TL00_VE";
	hisi,modem_id = <0X39651800>;
	hisi,product_name = "VCE-TL00";

    huawei_imx350: huawei,imx350 {
	    compatible = "huawei,imx350VCE";
	    status = "ok";
    };

    huawei_ov20880: huawei,ov20880 {
	    compatible = "huawei,ov20880VCE";
	    status = "ok";
    };
};

