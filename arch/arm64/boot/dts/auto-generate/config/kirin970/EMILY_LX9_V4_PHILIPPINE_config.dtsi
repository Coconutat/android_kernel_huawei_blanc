
/**
 * Copyright (C) 2014 Hisilicon Ltd.
 *
 *  This program is free software; you can redistribute it and/or modify
 *  it under the terms of the GNU General Public License version 2 as
 *  publishhed by the Free Software Foundation.
 */

/include/ "huawei_cc_anti_corrosion.dtsi"
/include/ "EMILY_LX9_V3_PHILIPPINE_config.dtsi"

/ {
	hisi,boardid = <6 5 1 1>;
	hisi,boardname = "EMILY_LX9_V4_PHILIPPINE";
	hisi,product_id = <0x39022C00>;
	hisi,modem_id = <0x39022C00>;
	hisi,product_name = "EMILY-LX9";

	cc_anti_corrosion: cc_anti_corrosion {
		status = "disabled";
	};
};
