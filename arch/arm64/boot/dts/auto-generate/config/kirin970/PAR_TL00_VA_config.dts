
/**
 * Copyright (C) 2014 Hisilicon Ltd.
 *
 *  This program is free software; you can redistribute it and/or modify
 *  it under the terms of the GNU General Public License version 2 as
 *  publishhed by the Free Software Foundation.
 */

/dts-v1/;
/include/ "fastboot.dtsi"
/include/ "PAR_AL00_VA_config.dtsi"
/include/ "PAR_TL00_VA_pin.dtsi"
/include/ "PAR_TL00_VA_sec_pin.dtsi"
/include/ "PAR_TL00_VA_modem_pin.dtsi"

/ {
	hisi,boardid = <6 8 7 1>;
	hisi,boardname = "PAR_TL00_VA";
	hisi,modem_id = <0x39631800>;
	hisi,product_name = "PAR-TL00";
};
