
/**
 * Copyright (C) 2014 Hisilicon Ltd.
 *
 *  This program is free software; you can redistribute it and/or modify
 *  it under the terms of the GNU General Public License version 2 as
 *  publishhed by the Free Software Foundation.
 */

/dts-v1/;
/include/ "fastboot.dtsi"
/include/ "lcdkit/bkl_vn2/devkit_lcd.dtsi"
/include/ "BKL_AL00_DELETE9688_VN1_config.dtsi"
/include/ "BKL_AL00_DELETE9688_VN2_pin.dtsi"
/include/ "BKL_AL00_DELETE9688_VN2_sec_pin.dtsi"
/include/ "BKL_AL00_DELETE9688_VN2_modem_pin.dtsi"

/ {
	hisi,boardid = <6 9 4 4>;
	hisi,boardname = "BKL_AL00_DELETE9688_VN2";
	hisi,modem_id = <0x39605800>;
	huawei_lcd_panel: huawei,lcd_panel {
		product_id = <3002>;
	};
};