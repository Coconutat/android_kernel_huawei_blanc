
/**
 * Copyright (C) 2014 Hisilicon Ltd.
 *
 *  This program is free software; you can redistribute it and/or modify
 *  it under the terms of the GNU General Public License version 2 as
 *  publishhed by the Free Software Foundation.
 */

/include/ "EMILY_TUGL_V3_config.dtsi"

/ {
	hisi,boardid = <6 5 0 5>;
	hisi,boardname = "EMILY_TUGL_V3_POWER";
	hisi,product_id = <0x39021000>;
	hisi,modem_id = <0x39021000>;
	hisi,product_name = "EMILY-AL00";
};
