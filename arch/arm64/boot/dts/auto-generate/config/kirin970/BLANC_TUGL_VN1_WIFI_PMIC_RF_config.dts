
/**
 * Copyright (C) 2014 Hisilicon Ltd.
 *
 *  This program is free software; you can redistribute it and/or modify
 *  it under the terms of the GNU General Public License version 2 as
 *  publishhed by the Free Software Foundation.
 */

/dts-v1/;
/include/ "fastboot.dtsi"
/include/ "BLANC_TUGL_V3_9688_config.dtsi"
/include/ "BLANC_TUGL_VN1_WIFI_PMIC_RF_pin.dtsi"
/include/ "BLANC_TUGL_VN1_WIFI_PMIC_RF_sec_pin.dtsi"
/include/ "BLANC_TUGL_VN1_WIFI_PMIC_RF_modem_pin.dtsi"

/ {
	hisi,boardid = <6 4 5 6>;
	hisi,boardname = "BLANC_TUGL_VN1_WIFI_PMIC_RF";
	hisi,product_id = <0x39011C00>;
	hisi,modem_id = <0x39011C00>;
};
