
/**
 * Copyright (C) 2014 Hisilicon Ltd.
 *
 *  This program is free software; you can redistribute it and/or modify
 *  it under the terms of the GNU General Public License version 2 as
 *  publishhed by the Free Software Foundation.
 */

/dts-v1/;
/include/ "fastboot.dtsi"
/include/ "ALPS_TUGL_V3_CS_2LANE_config.dtsi"
/include/ "ALPS_TUGL_V4_CS_A3B2_pin.dtsi"
/include/ "ALPS_TUGL_V4_CS_A3B2_sec_pin.dtsi"
/include/ "ALPS_TUGL_V4_CS_A3B2_modem_pin.dtsi"

/ {
	hisi,boardid = <6 4 1 8>;
	hisi,boardname = "ALPS_TUGL_V4_CS_A3B2";
	hisi,product_id = <0x39002800>;
	hisi,modem_id = <0x39002800>;
	direct_charger: direct_charger{
		scp_work_on_charger = <0>;
		status = "ok";
	};
};
