
/**
 * Copyright (C) 2014 Hisilicon Ltd.
 *
 *  This program is free software; you can redistribute it and/or modify
 *  it under the terms of the GNU General Public License version 2 as
 *  publishhed by the Free Software Foundation.
 */

/include/ "CHARLOTTE_TUGL_V1_config.dtsi"

/ {
	hisi,boardid = <6 5 2 3>;
	hisi,boardname = "CHARLOTTE_TUGL_V2_POWER";
	hisi,product_id = <0x39030800>;
	hisi,modem_id = <0x39030800>;
	hisi,product_name = "CLT-AL00";
};
