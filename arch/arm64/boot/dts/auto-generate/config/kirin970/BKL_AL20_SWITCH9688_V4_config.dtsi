
/**
 * Copyright (C) 2014 Hisilicon Ltd.
 *
 *  This program is free software; you can redistribute it and/or modify
 *  it under the terms of the GNU General Public License version 2 as
 *  publishhed by the Free Software Foundation.
 */

/include/ "BKL_AL20_V4_config.dtsi"

/ {
	hisi,boardid = <6 9 1 5>;
	hisi,boardname = "BKL_AL20_SWITCH9688_V4";
	hisi,modem_id = <0x39602800>;
};
