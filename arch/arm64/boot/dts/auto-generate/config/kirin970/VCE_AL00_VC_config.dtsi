
/**
 * Copyright (C) 2014 Hisilicon Ltd.
 *
 *  This program is free software; you can redistribute it and/or modify
 *  it under the terms of the GNU General Public License version 2 as
 *  publishhed by the Free Software Foundation.
 */

/include/ "VCE_AL00_VB_config.dtsi"

/ {
	hisi,boardid = <6 9 7 5>;
	hisi,boardname = "VCE_AL00_VC";
	hisi,modem_id = <0X39650C00>;
};
