
/**
 * Copyright (C) 2014 Hisilicon Ltd.
 *
 *  This program is free software; you can redistribute it and/or modify
 *  it under the terms of the GNU General Public License version 2 as
 *  publishhed by the Free Software Foundation.
 */

/include/ "lcdkit/cor_vn2/devkit_lcd.dtsi"
/include/ "COR_AL10_VD_config.dtsi"

/ {
	hisi,boardid = <6 9 2 9>;
	hisi,boardname = "COR_AL10_VE";
	hisi,modem_id = <0x39643800>;
	hisi,product_name = "COR-AL10";
	huawei_lcd_panel: huawei,lcd_panel {
		product_id = <9002>;
	};
};
