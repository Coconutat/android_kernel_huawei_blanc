
/**
 * Copyright (C) 2014 Hisilicon Ltd.
 *
 *  This program is free software; you can redistribute it and/or modify
 *  it under the terms of the GNU General Public License version 2 as
 *  publishhed by the Free Software Foundation.
 */

/dts-v1/;
/include/ "fastboot.dtsi"
/include/ "PAR_TL00_VA_config.dtsi"
/include/ "PAR_TL20_VB_pin.dtsi"
/include/ "PAR_TL20_VB_sec_pin.dtsi"
/include/ "PAR_TL20_VB_modem_pin.dtsi"

/ {
	hisi,boardid = <6 8 8 2>;
	hisi,boardname = "PAR_TL20_VB";
	hisi,modem_id = <0x39633000>;
	hisi,product_name = "PAR-TL20";
	/*hisi connectivity customize*/
	hisi_cust_cfg: hisi_cust_cfg {
		compatible = "hi1102,customize";
		ini_file_name = "/vendor/etc/cfg_paris_tl2hkb_hisi.ini";
	};
};
