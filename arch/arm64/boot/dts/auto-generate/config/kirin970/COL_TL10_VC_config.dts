
/**
 * Copyright (C) 2014 Hisilicon Ltd.
 *
 *  This program is free software; you can redistribute it and/or modify
 *  it under the terms of the GNU General Public License version 2 as
 *  publishhed by the Free Software Foundation.
 */

/dts-v1/;
/include/ "fastboot.dtsi"
/include/ "huawei_antenna_board_match.dtsi"
/include/ "COL_TL10_VB_config.dtsi"
/include/ "COL_TL10_VC_pin.dtsi"
/include/ "COL_TL10_VC_sec_pin.dtsi"
/include/ "COL_TL10_VC_modem_pin.dtsi"

/ {
	hisi,boardid = <6 8 1 6>;
	hisi,boardname = "COL_TL10_VC";
	hisi,modem_id = <0x39614800>;

	hw_antenna_board_match:hw_antenna_board_match{
		status = "ok";
	};
	antenna_board_adc_match:antenna_board_adc_match{
		status = "ok";
	};
};
