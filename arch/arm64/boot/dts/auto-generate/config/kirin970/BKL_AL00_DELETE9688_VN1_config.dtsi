
/**
 * Copyright (C) 2014 Hisilicon Ltd.
 *
 *  This program is free software; you can redistribute it and/or modify
 *  it under the terms of the GNU General Public License version 2 as
 *  publishhed by the Free Software Foundation.
 */

/include/ "BKL_AL00_V4_config.dtsi"

/ {
	hisi,boardid = <6 9 1 6>;
	hisi,boardname = "BKL_AL00_DELETE9688_VN1";
	hisi,modem_id = <0x39604800>;
};