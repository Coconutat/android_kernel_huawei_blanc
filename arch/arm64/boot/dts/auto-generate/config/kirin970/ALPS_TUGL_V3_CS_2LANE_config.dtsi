
/**
 * Copyright (C) 2014 Hisilicon Ltd.
 *
 *  This program is free software; you can redistribute it and/or modify
 *  it under the terms of the GNU General Public License version 2 as
 *  publishhed by the Free Software Foundation.
 */

/include/ "ALPS_TUGL_V1_CS_config.dtsi"

/ {
	hisi,boardid = <6 4 0 9>;
	hisi,boardname = "ALPS_TUGL_V3_CS_2LANE";
	hisi,product_id = <0x39002000>;
	hisi,modem_id = <0x39002000>;
};
