
/**
 * Copyright (C) 2014 Hisilicon Ltd.
 *
 *  This program is free software; you can redistribute it and/or modify
 *  it under the terms of the GNU General Public License version 2 as
 *  publishhed by the Free Software Foundation.
 */

/dts-v1/;
/include/ "fastboot.dtsi"
/include/ "ALPS_TUGL_V1_CS_config.dtsi"
/include/ "ALPS_TUGL_V3_CS_RADIO_pin.dtsi"
/include/ "ALPS_TUGL_V3_CS_RADIO_sec_pin.dtsi"
/include/ "ALPS_TUGL_V3_CS_RADIO_modem_pin.dtsi"

/ {
	hisi,boardid = <6 4 1 2>;
	hisi,boardname = "ALPS_TUGL_V3_CS_RADIO";
	hisi,product_id = <0x39001800>;
	hisi,modem_id = <0x39001800>;
};
