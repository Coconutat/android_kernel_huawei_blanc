
/**
 * Copyright (C) 2014 Hisilicon Ltd.
 *
 *  This program is free software; you can redistribute it and/or modify
 *  it under the terms of the GNU General Public License version 2 as
 *  publishhed by the Free Software Foundation.
 */

/include/ "ALPS_LX9_VN1_CS_JDI_config.dtsi"

/ {
	hisi,boardid = <6 4 2 1>;
	hisi,boardname = "ALPS_LX9_VN1_CS_G_WIFI_PMIC";
	hisi,product_id = <0x39004800>;
	hisi,modem_id = <0x39004800>;
};
