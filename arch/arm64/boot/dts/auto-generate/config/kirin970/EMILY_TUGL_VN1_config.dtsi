
/**
 * Copyright (C) 2014 Hisilicon Ltd.
 *
 *  This program is free software; you can redistribute it and/or modify
 *  it under the terms of the GNU General Public License version 2 as
 *  publishhed by the Free Software Foundation.
 */

/include/ "huawei_cc_anti_corrosion.dtsi"
/include/ "EMILY_TUGL_V4_config.dtsi"

/ {
	hisi,boardid = <6 5 1 2>;
	hisi,boardname = "EMILY_TUGL_VN1";
	hisi,product_id = <0x39023000>;
	hisi,modem_id = <0x39023000>;
	hisi,product_name = "EMILY-AL00";
};
