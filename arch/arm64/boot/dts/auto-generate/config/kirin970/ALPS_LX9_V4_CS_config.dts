
/**
 * Copyright (C) 2014 Hisilicon Ltd.
 *
 *  This program is free software; you can redistribute it and/or modify
 *  it under the terms of the GNU General Public License version 2 as
 *  publishhed by the Free Software Foundation.
 */

/dts-v1/;
/include/ "fastboot.dtsi"
/include/ "ALPS_LX9_V3_CS_2LANE_config.dtsi"
/include/ "ALPS_LX9_V4_CS_pin.dtsi"
/include/ "ALPS_LX9_V4_CS_sec_pin.dtsi"
/include/ "ALPS_LX9_V4_CS_modem_pin.dtsi"

/ {
	hisi,boardid = <6 4 1 3>;
	hisi,boardname = "ALPS_LX9_V4_CS";
	hisi,product_id = <0x39002C00>;
	hisi,modem_id = <0x39002C00>;
};
